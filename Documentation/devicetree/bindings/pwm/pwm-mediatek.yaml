## Documentation/devicetree/bindings/pwm/pwm-mediatek.yaml
```yaml
# SPDX-License-Identifier: (GPL-2.0-only OR BSD-2-Clause)
# Copyright (C) 2020 SiFive, Inc.
%YAML 1.2
---
$id: http://devicetree.org/schemas/pwm/pwm-mediatek.yaml#
$schema: http://devicetree.org/meta-schemas/core.yaml#

title: MediaTek PWM controller

maintainers:
  - Thierry Reding <thierry.reding@gmail.com>
  - Lee Jones <lee.jones@linaro.org>
  - Matthias Brugger <matthias.bgg@gmail.com>

properties:
  compatible:
    oneOf:
      - enum:
          - mediatek,mt2712-pwm
          - mediatek,mt7622-pwm
          - mediatek,mt7623-pwm
          - mediatek,mt7628-pwm
          - mediatek,mt7629-pwm
          - mediatek,mt8183-pwm
          - mediatek,mt8365-pwm
          - mediatek,mt8516-pwm

  reg:
    maxItems: 1

  clocks:
    minItems: 3
    maxItems: 10

  clock-names: true

  "#pwm-cells":
    const: 2

  interrupts:
    maxItems: 1

required:
  - compatible
  - reg
  - clocks
  - clock-names
  - "#pwm-cells"

allOf:
  - if:
      properties:
        compatible:
          contains:
            const: mediatek,mt2712-pwm
    then:
      properties:
        clock-names:
          items:
            - const: top
            - const: main
            - const: pwm1
            - const: pwm2
            - const: pwm3
            - const: pwm4
            - const: pwm5
            - const: pwm6
            - const: pwm7
            - const: pwm8
  - if:
      properties:
        compatible:
          contains:
            const: mediatek,mt7622-pwm
    then:
      properties:
        clock-names:
          items:
            - const: top
            - const: main
            - const: pwm1
            - const: pwm2
            - const: pwm3
            - const: pwm4
            - const: pwm5
            - const: pwm6
  - if:
      properties:
        compatible:
          contains:
            const: mediatek,mt7623-pwm
    then:
      properties:
        clock-names:
          items:
            - const: top
            - const: main
            - const: pwm1
            - const: pwm2
            - const: pwm3
            - const: pwm4
            - const: pwm5
  - if:
      properties:
        compatible:
          contains:
            const: mediatek,mt7629-pwm
    then:
      properties:
        clock-names:
          items:
            - const: top
            - const: main
            - const: pwm1

additionalProperties: false

examples:
  - |
    #include <dt-bindings/clock/mt2701-clk.h>
    pwm0: pwm@11006000 {
      compatible = "mediatek,mt7623-pwm";
      reg = <0x11006000 0x1000>;
      #pwm-cells = <2>;
      clocks = <&topckgen CLK_TOP_PWM_SEL>,
        <&pericfg CLK_PERI_PWM>,
        <&pericfg CLK_PERI_PWM1>,
        <&pericfg CLK_PERI_PWM2>,
        <&pericfg CLK_PERI_PWM3>,
        <&pericfg CLK_PERI_PWM4>,
        <&pericfg CLK_PERI_PWM5>;
      clock-names = "top", "main", "pwm1", "pwm2",
                    "pwm3", "pwm4", "pwm5";
      pinctrl-names = "default";
      pinctrl-0 = <&pwm0_pins>;
    };
```

## Documentation/devicetree/bindings/regulator/mediatek,mt6357-regulator.yaml
```yaml
# SPDX-License-Identifier: (GPL-2.0 OR BSD-2-Clause)
%YAML 1.2
---
$id: http://devicetree.org/schemas/regulator/mediatek,mt6357-regulator.yaml#
$schema: http://devicetree.org/meta-schemas/core.yaml#

title: MediaTek MT6357 Regulators

maintainers:
  - Fabien Parent <fparent@baylibre.com>

description: |
  List of regulators provided by this controller. It is named
  according to its regulator type, buck-<name> and ldo-<name>.
  MT6357 regulators node should be sub node of the MT6397 MFD node.

patternProperties:
  "^buck-v(core|modem|pa|proc|s1)$":
    type: object
    $ref: "regulator.yaml#"

    properties:
      regulator-name:
        pattern: "^v(core|modem|pa|proc|s1)$"

    unevaluatedProperties: false

  "^ldo-v(aud28|aux18|cama|camd|cn18|cn28|cn33-bt|cn33-wifi|dram)$":
    type: object
    $ref: "regulator.yaml#"

    properties:
      regulator-name:
        pattern: "^v(aud28|aux18|cama|camd|cn18|cn28|cn33-bt|cn33-wifi|dram)$"

    unevaluatedProperties: false

  "^ldo-v(efuse|emc|ibr|io18|io28|ldo28|mch|rf12|rf18)$":
    type: object
    $ref: "regulator.yaml#"

    properties:
      regulator-name:
        pattern: "^v(efuse|emc|ibr|io18|io28|ldo28|mch|rf12|rf18)$"

    unevaluatedProperties: false

  "^ldo-v(xo22|sim1,sim2|sram-others|sram-proc|usb33|xo22)$":
    type: object
    $ref: "regulator.yaml#"

    properties:
      regulator-name:
        pattern: "^v(xo22|sim1,sim2|sram-others|sram-proc|usb33|xo22)$"

    unevaluatedProperties: false

additionalProperties: false

examples:
  - |
    pmic {
      regulators {
        mt6357_vproc_reg: buck-vproc {
          regulator-name = "vproc";
          regulator-min-microvolt = <518750>;
          regulator-max-microvolt = <1312500>;
          regulator-ramp-delay = <6250>;
          regulator-enable-ramp-delay = <220>;
          regulator-always-on;
        };
        mt6357_vcore_reg: buck-vcore {
          regulator-name = "vcore";
          regulator-min-microvolt = <518750>;
          regulator-max-microvolt = <1312500>;
          regulator-ramp-delay = <6250>;
          regulator-enable-ramp-delay = <220>;
          regulator-always-on;
        };
        mt6357_vmodem_reg: buck-vmodem {
          regulator-name = "vmodem";
          regulator-min-microvolt = <500000>;
          regulator-max-microvolt = <1193750>;
          regulator-ramp-delay = <6250>;
          regulator-enable-ramp-delay = <220>;
        };
        mt6357_vs1_reg: buck-vs1 {
          regulator-name = "vs1";
          regulator-min-microvolt = <1200000>;
          regulator-max-microvolt = <2200000>;
          regulator-ramp-delay = <12500>;
          regulator-enable-ramp-delay = <220>;
          regulator-always-on;
        };
        mt6357_vpa_reg: buck-vpa {
          regulator-name = "vpa";
          regulator-min-microvolt = <500000>;
          regulator-max-microvolt = <3650000>;
          regulator-ramp-delay = <50000>;
          regulator-enable-ramp-delay = <220>;
        };
        mt6357_vfe28_reg: ldo-vfe28 {
          compatible = "regulator-fixed";
          regulator-name = "vfe28";
          regulator-min-microvolt = <2800000>;
          regulator-max-microvolt = <2800000>;
          regulator-enable-ramp-delay = <264>;
        };
        mt6357_vxo22_reg: ldo-vxo22 {
          regulator-name = "vxo22";
          regulator-min-microvolt = <2200000>;
          regulator-max-microvolt = <2400000>;
          regulator-enable-ramp-delay = <110>;
        };
        mt6357_vrf18_reg: ldo-vrf18 {
          compatible = "regulator-fixed";
          regulator-name = "vrf18";
          regulator-min-microvolt = <1800000>;
          regulator-max-microvolt = <1800000>;
          regulator-enable-ramp-delay = <110>;
        };
        mt6357_vrf12_reg: ldo-vrf12 {
          compatible = "regulator-fixed";
          regulator-name = "vrf12";
          regulator-min-microvolt = <1200000>;
          regulator-max-microvolt = <1200000>;
          regulator-enable-ramp-delay = <110>;
        };
        mt6357_vefuse_reg: ldo-vefuse {
          regulator-name = "vefuse";
          regulator-min-microvolt = <1200000>;
          regulator-max-microvolt = <3300000>;
          regulator-enable-ramp-delay = <264>;
        };
        mt6357_vcn33_bt_reg: ldo-vcn33-bt {
          regulator-name = "vcn33-bt";
          regulator-min-microvolt = <3300000>;
          regulator-max-microvolt = <3500000>;
          regulator-enable-ramp-delay = <264>;
        };
        mt6357_vcn33_wifi_reg: ldo-vcn33-wifi {
          regulator-name = "vcn33-wifi";
          regulator-min-microvolt = <3300000>;
          regulator-max-microvolt = <3500000>;
          regulator-enable-ramp-delay = <264>;
        };
        mt6357_vcn28_reg: ldo-vcn28 {
          compatible = "regulator-fixed";
          regulator-name = "vcn28";
          regulator-min-microvolt = <2800000>;
          regulator-max-microvolt = <2800000>;
          regulator-enable-ramp-delay = <264>;
        };
        mt6357_vcn18_reg: ldo-vcn18 {
          compatible = "regulator-fixed";
          regulator-name = "vcn18";
          regulator-min-microvolt = <1800000>;
          regulator-max-microvolt = <1800000>;
          regulator-enable-ramp-delay = <264>;
        };
        mt6357_vcama_reg: ldo-vcama {
          regulator-name = "vcama";
          regulator-min-microvolt = <2500000>;
          regulator-max-microvolt = <2800000>;
          regulator-enable-ramp-delay = <264>;
        };
        mt6357_vcamd_reg: ldo-vcamd {
          regulator-name = "vcamd";
          regulator-min-microvolt = <1000000>;
          regulator-max-microvolt = <1800000>;
          regulator-enable-ramp-delay = <264>;
        };
        mt6357_vcamio_reg: ldo-vcamio18 {
          compatible = "regulator-fixed";
          regulator-name = "vcamio";
          regulator-min-microvolt = <1800000>;
          regulator-max-microvolt = <1800000>;
          regulator-enable-ramp-delay = <264>;
        };
        mt6357_vldo28_reg: ldo-vldo28 {
          regulator-name = "vldo28";
          regulator-min-microvolt = <2800000>;
          regulator-max-microvolt = <3000000>;
          regulator-enable-ramp-delay = <264>;
        };
        mt6357_vsram_others_reg: ldo-vsram-others {
          regulator-name = "vsram-others";
          regulator-min-microvolt = <518750>;
          regulator-max-microvolt = <1312500>;
          regulator-ramp-delay = <6250>;
          regulator-enable-ramp-delay = <110>;
          regulator-always-on;
        };
        mt6357_vsram_proc_reg: ldo-vsram-proc {
          regulator-name = "vsram-proc";
          regulator-min-microvolt = <518750>;
          regulator-max-microvolt = <1312500>;
          regulator-ramp-delay = <6250>;
          regulator-enable-ramp-delay = <110>;
          regulator-always-on;
        };
        mt6357_vaux18_reg: ldo-vaux18 {
          compatible = "regulator-fixed";
          regulator-name = "vaux18";
          regulator-min-microvolt = <1800000>;
          regulator-max-microvolt = <1800000>;
          regulator-enable-ramp-delay = <264>;
        };
        mt6357_vaud28_reg: ldo-vaud28 {
          compatible = "regulator-fixed";
          regulator-name = "vaud28";
          regulator-min-microvolt = <2800000>;
          regulator-max-microvolt = <2800000>;
          regulator-enable-ramp-delay = <264>;
        };
        mt6357_vio28_reg: ldo-vio28 {
          compatible = "regulator-fixed";
          regulator-name = "vio28";
          regulator-min-microvolt = <2800000>;
          regulator-max-microvolt = <2800000>;
          regulator-enable-ramp-delay = <264>;
        };
        mt6357_vio18_reg: ldo-vio18 {
          compatible = "regulator-fixed";
          regulator-name = "vio18";
          regulator-min-microvolt = <1800000>;
          regulator-max-microvolt = <1800000>;
          regulator-enable-ramp-delay = <264>;
          regulator-always-on;
        };
        mt6357_vdram_reg: ldo-vdram {
          regulator-name = "vdram";
          regulator-min-microvolt = <1100000>;
          regulator-max-microvolt = <1200000>;
          regulator-enable-ramp-delay = <3300>;
        };
        mt6357_vmc_reg: ldo-vmc {
          regulator-name = "vmc";
          regulator-min-microvolt = <1800000>;
          regulator-max-microvolt = <3300000>;
          regulator-enable-ramp-delay = <44>;
        };
        mt6357_vmch_reg: ldo-vmch {
          regulator-name = "vmch";
          regulator-min-microvolt = <2900000>;
          regulator-max-microvolt = <3300000>;
          regulator-enable-ramp-delay = <44>;
        };
        mt6357_vemc_reg: ldo-vemc {
          regulator-name = "vemc";
          regulator-min-microvolt = <2900000>;
          regulator-max-microvolt = <3300000>;
          regulator-enable-ramp-delay = <44>;
          regulator-always-on;
        };
        mt6357_vsim1_reg: ldo-vsim1 {
          regulator-name = "vsim1";
          regulator-min-microvolt = <1700000>;
          regulator-max-microvolt = <3100000>;
          regulator-enable-ramp-delay = <264>;
        };
        mt6357_vsim2_reg: ldo-vsim2 {
          regulator-name = "vsim2";
          regulator-min-microvolt = <1700000>;
          regulator-max-microvolt = <3100000>;
          regulator-enable-ramp-delay = <264>;
        };
        mt6357_vibr_reg: ldo-vibr {
          regulator-name = "vibr";
          regulator-min-microvolt = <1200000>;
          regulator-max-microvolt = <3300000>;
          regulator-enable-ramp-delay = <44>;
        };
        mt6357_vusb33_reg: ldo-vusb33 {
          regulator-name = "vusb33";
          regulator-min-microvolt = <3000000>;
          regulator-max-microvolt = <3100000>;
          regulator-enable-ramp-delay = <264>;
        };
      };
    };
...
```

## Documentation/devicetree/bindings/regulator/onnn,ncv6336.yaml
```yaml
# SPDX-License-Identifier: GPL-2.0-only OR BSD-2-Clause
%YAML 1.2
---
$id: http://devicetree.org/schemas/regulator/onnn,ncv6336.yaml#
$schema: http://devicetree.org/meta-schemas/core.yaml#

title: Onsemi NCV6336 Buck converter

maintainers:
  - Fabien Parent <fabien.parent@linaro.org>

description: |
  The NCV6336 is an I2C programmable BUCK (step-down) converter.
  It is designed for mobile power applications.

properties:
  $nodename:
    pattern: "regulator@[0-9a-f]{2}"
  compatible:
    enum:
      - onnn,ncv6336

  reg:
    maxItems: 1

required:
  - compatible
  - reg

additionalProperties: false

examples:
  - |
    i2c {
        #address-cells = <1>;
        #size-cells = <0>;

        regulator@1c {
            compatible = "onnn,ncv6336";
            reg = <0x1c>;
       };
     };
...
```
